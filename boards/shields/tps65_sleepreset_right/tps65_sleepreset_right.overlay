/*
 * Test (task 08 step 6b): hold the right TPS65 in reset while ZMK
 * sleeps or is soft-off (src/tps65_sleep_reset.c). Same RST pin as the
 * trackpad node in tps65_right_aym: P1.04 (header 1.04), active low.
 */

#include <zephyr/dt-bindings/gpio/gpio.h>

/ {
    tps65_sleep_reset: tps65_sleep_reset {
        compatible = "zmk,tps65-sleep-reset";
        reset-gpios = <&gpio1 4 GPIO_ACTIVE_LOW>;
    };
};
